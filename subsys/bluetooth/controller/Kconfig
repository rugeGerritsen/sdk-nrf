## subsys/bluetooth/controller/Kconfig
```kconfig
menu "Nordic BLE controller"

config BLECTLR_PRIO
	# Hidden option to set the priority of the controller threads
	int
	default BT_RX_PRIO if BT_HCI_HOST || BT_RECV_IS_RX_THREAD
	default 8

config BLECTLR_RX_STACK_SIZE
	int "Size of the receive thread stack"
	default 1024
	help
	  Size of the receiving thread stack, used to retrieve HCI events and
	  data from the controller.

config BLECTLR_SIGNAL_STACK_SIZE
	int "Size of the signal handler thread stack"
	default 1024
	help
	  Size of the signal handler thread stack, used to process lower
	  priority signals in the controller.
# The BLE controller library variants are defined in nrfxlib, here we redefine
# the choice to 'import' them, so they appear in the same menu as the rest.

choice BLE_CONTROLLER_VARIANT
	prompt "BLE Controller variant"
	bool

endchoice


comment "Thread safety behavior of BLE controller APIs"

config BLECTLR_THREADSAFETY
	bool "Enable API blocking for thread safety"
	depends on MULTITHREADING
	default y
	help
		Public API calls such as Crypto and HCI APIs will block
		if called by multiple threads simultaneously. Only one thread
		can access the APIs at a time.
config BLECTLR_THREADSAFETY_LOCK_TIMEOUT_MSEC
	int "Blocking timeout value (in milliseconds)."
	depends on BLECTLR_THREADSAFETY
	default 10
	help
		This option can take three kinds of values. -1: API is (forever) blocking, 0: API
		is not blocking, n: API blocks for a given number of milliseconds until it could be
		locked.

endmenu

if FLASH
config SOC_FLASH_NRF_LL_NRFXLIB
	bool "Nordic BLE controller flash driver"
	default y
	select FLASH_HAS_PAGE_LAYOUT
	select FLASH_HAS_DRIVER_ENABLED
	select MPU_ALLOW_FLASH_WRITE if CPU_HAS_MPU
	help
		Enables Nordic BLE controller flash driver.

endif # FLASH

if ENTROPY_GENERATOR

config ENTROPY_NRF_LL_NRFXLIB
  bool "Nordic BLE controller entropy driver"
	default y
	depends on ENTROPY_GENERATOR
	depends on SOC_COMPATIBLE_NRF
	select ENTROPY_HAS_DRIVER
	help
	  This option enables the RNG peripheral, which is a random number
	  generator, based on internal thermal noise, that provides a
	  random 8-bit value to the host when read.

endif # ENTROPY_GENERATOR

config CLOCK_CONTROL_NRF_LL_NRFXLIB
  bool "Nordic BLE controller clock control driver"
	default y

config CLOCK_CONTROL_NRF5_M16SRC_DRV_NAME
	string "NRF5 16MHz clock device name"
	default "clk_m16src"

config CLOCK_CONTROL_NRF5_K32SRC_DRV_NAME
	string "NRF5 32KHz clock device name"
	default "clk_k32src"

choice CLOCK_CONTROL_NR5_SOURCE
	prompt "32KHz clock source"
	default CLOCK_CONTROL_NRF5_K32SRC_XTAL

config CLOCK_CONTROL_NRF5_K32SRC_RC
	bool "RC Oscillator"

config CLOCK_CONTROL_NRF5_K32SRC_XTAL
	bool "Crystal Oscillator"

config CLOCK_CONTROL_NRF5_K32SRC_SYNTH
	bool "Synthesized from HFCLK"

endchoice

config CLOCK_CONTROL_NRF5_K32SRC_BLOCKING
	bool "Blocking 32KHz crystal oscillator startup"
	depends on CLOCK_CONTROL_NRF5_K32SRC_XTAL
	help
	  Clock control driver will spin wait in CPU sleep until 32KHz
	  crystal oscillator starts up. If not enabled, RC oscillator will
	  initially start running and automatically switch to crystal when
	  ready.

choice CLOCK_CONTROL_NR5_ACCURACY
	prompt "32KHz clock accuracy"
	default CLOCK_CONTROL_NRF5_K32SRC_500PPM if CLOCK_CONTROL_NRF5_K32SRC_RC
	default CLOCK_CONTROL_NRF5_K32SRC_20PPM

config CLOCK_CONTROL_NRF5_K32SRC_500PPM
	bool "251 ppm to 500 ppm"

config CLOCK_CONTROL_NRF5_K32SRC_250PPM
	bool "151 ppm to 250 ppm"

config CLOCK_CONTROL_NRF5_K32SRC_150PPM
	bool "101 ppm to 150 ppm"

config CLOCK_CONTROL_NRF5_K32SRC_100PPM
	bool "76 ppm to 100 ppm"

config CLOCK_CONTROL_NRF5_K32SRC_75PPM
	bool "51 ppm to 75 ppm"

config CLOCK_CONTROL_NRF5_K32SRC_50PPM
	bool "31 ppm to 50 ppm"

config CLOCK_CONTROL_NRF5_K32SRC_30PPM
	bool "21 ppm to 30 ppm"

config CLOCK_CONTROL_NRF5_K32SRC_20PPM
	bool "0 ppm to 20 ppm"

config CLOCK_CONTROL_NRF5_K32SRC_10PPM
	bool "6 ppm to 10 ppm"

config CLOCK_CONTROL_NRF5_K32SRC_5PPM
	bool "3 ppm to 5 ppm"

config CLOCK_CONTROL_NRF5_K32SRC_2PPM
	bool "2 ppm"

config CLOCK_CONTROL_NRF5_K32SRC_1PPM
	bool "1 ppm"

endchoice


config ENTROPY_NRF5_PRI
	int "RNG interrupt priority"
	range 0 2 if SOC_SERIES_NRF51X
	range 0 5 if SOC_COMPATIBLE_NRF52X
	default 2 if SOC_SERIES_NRF51X
	default 5 if SOC_COMPATIBLE_NRF52X
	help
	  nRF5X RNG IRQ priority.
```
